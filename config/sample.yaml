## config/sample.yaml
```yaml
data:
  data: QM93D
  dir: './data'
  batch_size: 1000

ckpt: ckpt

sampler:
  predictor: Reverse
  corrector: Langevin
  snr: 0.2
  scale_eps: 0.7
  n_steps: 1

sample:
  use_ema: False
  noise_removal: True
  probability_flow: False
  eps: 1.0e-4
  seed: 60
```
